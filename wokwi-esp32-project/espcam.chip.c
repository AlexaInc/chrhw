// ============================================================================
//  ESP32-CAM (serial protocol) chip for Wokwi  -  single file, drop-in
// ----------------------------------------------------------------------------
//  This chip replaces the whole ESP32-CAM board of your robot. Wire it to the
//  main board's UART0 (TX0 / RX0) exactly like the real camera:
//
//        main board TX0 ──────► chip RX
//        main board RX0 ◄────── chip TX
//
//  It speaks the same protocol as your camera firmware, at 921600 baud:
//
//        main board :  'C'
//        chip       :  "<IMG:2945>" followed by 2945 raw JPEG bytes
//
//  So Serial.find("<IMG:"), Serial.parseInt(), Serial.read()=='>' and
//  Serial.readBytes(imgBuffer, imgSize) in captureAndUploadImage() all work
//  with the main-board code COMPLETELY UNCHANGED. No shim header, no
//  #ifdef, nothing added to the sketch.
//
//  Pins
//      GND  VCC   power (cosmetic)
//      RX         <- main board TX0 (GPIO1)
//      TX         -> main board RX0 (GPIO3)
//      TRIG       rising edge = take a photo (push button, optional)
//      BUSY       HIGH while the image is being sent (LED, optional)
//
//  Controls
//      scene            0 colour bars · 1 leaf · 2 no answer (timeout test)
//                       3 truncated image (tests the "Partial image" branch)
//      captureLatencyMs delay between 'C' and the "<IMG:" header
//      triggerMode      0 smart (default) · 1 any 'C' byte · 2 TRIG pin only
//      idleGapMs        smart mode: silence required before a bare 'C'
//
//  Why "smart" trigger mode is the default: your main board shares UART0
//  between the Serial Monitor and the camera, so every [DEBUG] line is also
//  sent to this chip. Letters 'C' inside words like "[CAM]" or "CONNECTED"
//  must NOT fire the shutter. In smart mode a 'C' only counts when it is the
//  first byte of a line (right after \n or \r) or arrives after a quiet gap -
//  which is exactly how Serial.print('C') appears on the wire.
// ============================================================================

#include "wokwi-api.h"
#include <stdio.h>
#include <string.h>
#include <stdlib.h>
#include <stdint.h>

#define UART_BAUD   921600        // must match Serial.begin(921600)
#define CHUNK_SIZE  64

#define SCENE_NO_ANSWER  2
#define SCENE_TRUNCATED  3

#define TRIGGER_SMART    0
#define TRIGGER_ANY_C    1
#define TRIGGER_PIN_ONLY 2

// ---- baked-in JPEG frames (regenerate with tools/make_frames.py) ----------
// <<<FRAMES_BEGIN>>>
#define CAM_FRAME_WIDTH  320
#define CAM_FRAME_HEIGHT 240

static const uint8_t frame_scene0[2945] = {
  0xff, 0xd8, 0xff, 0xe0, 0x00, 0x10, 0x4a, 0x46, 0x49, 0x46, 0x00, 0x01, 0x01, 0x00, 0x00, 0x01,
  0x00, 0x01, 0x00, 0x00, 0xff, 0xdb, 0x00, 0x43, 0x00, 0x14, 0x0e, 0x0f, 0x12, 0x0f, 0x0d, 0x14,
  0x12, 0x10, 0x12, 0x17, 0x15, 0x14, 0x18, 0x1e, 0x32, 0x21, 0x1e, 0x1c, 0x1c, 0x1e, 0x3d, 0x2c,
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  0xd9,
};

static const uint8_t frame_scene1[3203] = {
  0xff, 0xd8, 0xff, 0xe0, 0x00, 0x10, 0x4a, 0x46, 0x49, 0x46, 0x00, 0x01, 0x01, 0x00, 0x00, 0x01,
  0x00, 0x01, 0x00, 0x00, 0xff, 0xdb, 0x00, 0x43, 0x00, 0x14, 0x0e, 0x0f, 0x12, 0x0f, 0x0d, 0x14,
  0x12, 0x10, 0x12, 0x17, 0x15, 0x14, 0x18, 0x1e, 0x32, 0x21, 0x1e, 0x1c, 0x1c, 0x1e, 0x3d, 0x2c,
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  0x0f, 0xff, 0xd9,
};

// <<<FRAMES_END>>>

typedef struct {
  uart_dev_t uart;
  pin_t      pin_busy;

  uint32_t   attr_scene;
  uint32_t   attr_latency;
  uint32_t   attr_trigger_mode;
  uint32_t   attr_idle_gap;

  timer_t    shutter_timer;

  // transmit state
  uint8_t        header[24];
  uint32_t       header_len;
  uint32_t       header_pos;
  const uint8_t *payload;
  uint32_t       payload_len;
  uint32_t       payload_pos;
  uint8_t        chunk[CHUNK_SIZE];
  bool           sending;

  // receive state (used to tell a real trigger from debug text)
  uint8_t   last_byte;
  uint64_t  last_rx_ns;
} chip_state_t;

// ---------------------------------------------------------------- tx pump ---

static void pump(chip_state_t *chip) {
  if (chip->header_pos < chip->header_len) {
    uint32_t n = chip->header_len - chip->header_pos;
    if (n > CHUNK_SIZE) n = CHUNK_SIZE;
    memcpy(chip->chunk, chip->header + chip->header_pos, n);
    chip->header_pos += n;
    uart_write(chip->uart, chip->chunk, n);
    return;
  }

  if (chip->payload_pos < chip->payload_len) {
    uint32_t n = chip->payload_len - chip->payload_pos;
    if (n > CHUNK_SIZE) n = CHUNK_SIZE;
    memcpy(chip->chunk, chip->payload + chip->payload_pos, n);
    chip->payload_pos += n;
    uart_write(chip->uart, chip->chunk, n);
    return;
  }

  chip->sending = false;
  pin_write(chip->pin_busy, LOW);
}

// ------------------------------------------------------------ the shutter ---

static void on_shutter(void *user_data) {
  chip_state_t *chip = (chip_state_t *)user_data;
  uint32_t scene = attr_read(chip->attr_scene);

  if (scene == SCENE_NO_ANSWER) {
    printf("[esp32-cam] scene=2 -> staying silent (main board should time out)\n");
    return;
  }

  const uint8_t *frame = (scene == 1) ? frame_scene1 : frame_scene0;
  uint32_t full_len = (scene == 1) ? (uint32_t)sizeof(frame_scene1)
                                   : (uint32_t)sizeof(frame_scene0);
  uint32_t send_len = full_len;

  if (scene == SCENE_TRUNCATED) {
    send_len = full_len / 2;    // header says full_len, we send half
    printf("[esp32-cam] scene=3 -> announcing %u bytes but sending only %u\n",
           full_len, send_len);
  }

  // "<IMG:1234>" - exactly what the camera firmware prints
  int n = snprintf((char *)chip->header, sizeof(chip->header), "<IMG:%u>", full_len);
  chip->header_len  = (uint32_t)n;
  chip->header_pos  = 0;
  chip->payload     = frame;
  chip->payload_len = send_len;
  chip->payload_pos = 0;
  chip->sending     = true;
  pin_write(chip->pin_busy, HIGH);

  printf("[esp32-cam] capture: scene=%u, %ux%u JPEG -> <IMG:%u>\n",
         scene, CAM_FRAME_WIDTH, CAM_FRAME_HEIGHT, full_len);
  pump(chip);
}

static void take_photo(chip_state_t *chip) {
  if (chip->sending) {
    printf("[esp32-cam] busy, trigger ignored\n");
    return;
  }
  uint32_t latency = attr_read(chip->attr_latency);
  if (latency == 0) latency = 1;
  timer_start(chip->shutter_timer, latency * 1000, false);
}

// -------------------------------------------------------------- callbacks ---

static void on_uart_rx(void *user_data, uint8_t byte) {
  chip_state_t *chip = (chip_state_t *)user_data;

  uint64_t now = get_sim_nanos();
  uint64_t gap_ns = now - chip->last_rx_ns;
  uint8_t  prev = chip->last_byte;
  chip->last_byte  = byte;
  chip->last_rx_ns = now;

  if (byte != 'C') return;

  uint32_t mode = attr_read(chip->attr_trigger_mode);
  if (mode == TRIGGER_PIN_ONLY) return;

  if (mode == TRIGGER_ANY_C) {
    take_photo(chip);
    return;
  }

  // smart mode: a real Serial.print('C') stands alone on the wire
  uint64_t idle_ns = (uint64_t)attr_read(chip->attr_idle_gap) * 1000000ull;
  bool start_of_line = (prev == '\n' || prev == '\r' || prev == 0);
  if (start_of_line || gap_ns >= idle_ns) {
    take_photo(chip);
  }
}

static void on_uart_write_done(void *user_data) {
  pump((chip_state_t *)user_data);
}

static void on_trig_change(void *user_data, pin_t pin, uint32_t value) {
  (void)pin;
  (void)value;
  printf("[esp32-cam] TRIG pin pressed\n");
  take_photo((chip_state_t *)user_data);
}

// ------------------------------------------------------------------- init ---

void chip_init(void) {
  chip_state_t *chip = (chip_state_t *)calloc(1, sizeof(chip_state_t));

  chip->pin_busy          = pin_init("BUSY", OUTPUT_LOW);
  chip->attr_scene        = attr_init("scene", 0);
  chip->attr_latency      = attr_init("captureLatencyMs", 120);
  chip->attr_trigger_mode = attr_init("triggerMode", TRIGGER_SMART);
  chip->attr_idle_gap     = attr_init("idleGapMs", 20);

  pin_t trig = pin_init("TRIG", INPUT_PULLDOWN);
  const pin_watch_config_t trig_cfg = {
    .edge       = RISING,
    .pin_change = on_trig_change,
    .user_data  = chip,
  };
  pin_watch(trig, &trig_cfg);

  const timer_config_t timer_cfg = {
    .callback  = on_shutter,
    .user_data = chip,
  };
  chip->shutter_timer = timer_init(&timer_cfg);

  const uart_config_t uart_cfg = {
    .tx         = pin_init("TX", INPUT_PULLUP),
    .rx         = pin_init("RX", INPUT_PULLUP),
    .baud_rate  = UART_BAUD,
    .rx_data    = on_uart_rx,
    .write_done = on_uart_write_done,
    .user_data  = chip,
  };
  chip->uart = uart_init(&uart_cfg);

  printf("[esp32-cam] virtual ESP32-CAM ready: %ux%u JPEG, %u baud, "
         "waiting for 'C'\n", CAM_FRAME_WIDTH, CAM_FRAME_HEIGHT, UART_BAUD);
}
